## firmware/mica-shield-module/boards/shields/mica/Kconfig.defconfig
```kconfig
if SHIELD_MICA_LEFT

# Name must be less than 16 characters long!
config ZMK_KEYBOARD_NAME
    default "Mica Keyboard"

config ZMK_SPLIT_ROLE_CENTRAL
    default y

endif

if SHIELD_MICA_LEFT || SHIELD_MICA_RIGHT

config ZMK_SPLIT
    default y
config ZMK_SLEEP
    default y

endif
```

## firmware/mica-shield-module/boards/shields/mica/Kconfig.shield
```kconfig
config SHIELD_MICA_LEFT
    def_bool $(shields_list_contains,mica_left)

config SHIELD_MICA_RIGHT
    def_bool $(shields_list_contains,mica_right)
```
